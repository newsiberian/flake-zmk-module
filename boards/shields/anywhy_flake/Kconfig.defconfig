## boards/shields/anywhy_flake/Kconfig.defconfig
```kconfig
if SHIELD_ANYWHY_FLAKE_LEFT || SHIELD_ANYWHY_FLAKE_DONGLE

config ZMK_KEYBOARD_NAME
    default "Anywhy Flake"

config ZMK_SPLIT_ROLE_CENTRAL
    default y

config ZMK_STUDIO
    default y

endif

if SHIELD_ANYWHY_FLAKE_DONGLE

config ZMK_USB
    default y

config ZMK_SPLIT_BLE_CENTRAL_PERIPHERALS
    default 2

# BT_MAX_CONN = ZMK_SPLIT_BLE_CENTRAL_PERIPHERALS + desired BT profiles (default 5)
config BT_MAX_CONN
    default 7

config BT_MAX_PAIRED
    default 7

endif

if SHIELD_ANYWHY_FLAKE_LEFT || SHIELD_ANYWHY_FLAKE_RIGHT || SHIELD_ANYWHY_FLAKE_DONGLE || SHIELD_ANYWHY_FLAKE_PERIPHERAL_LEFT

config ZMK_SPLIT
    default y

endif
```
